## behaviors/Kconfig
```kconfig
menuconfig ZMK_BEHAVIOR_TRACKPAD_TO_POS
    bool "Trackpad to position behavior"
    default y
    help
      Enable the trackpad-to-position behavior that raises position_state_changed
      events for a virtual key position.

menuconfig ZMK_BEHAVIOR_ZIP_DYNAMIC_SCALE
    bool "Dynamic scale adjust behavior"
    default y
    help
      Enable the behavior that adjusts the dynamic scale factor used by
      the dynamic scaler input processor.

menuconfig ZMK_BEHAVIOR_ZIP_DYNAMIC_SCALE_SET
    bool "Dynamic scale set behavior"
    default y
    help
      Enable the behavior that sets the dynamic scale factor used by
      the dynamic scaler input processor.

menuconfig ZMK_BEHAVIOR_DRAG_CLICK
    bool "Drag click behavior"
    default y
    help
      A mouse button key that keeps the button pressed after the key is
      released for as long as a finger is on either trackpad. Uses the raw
      touch state event (INPUT_IQS9151_TOUCH_STATE_ENABLE) to know when the
      last finger leaves.

menuconfig ZMK_BEHAVIOR_PRESS_BOTH
    bool "Press-both behavior"
    default y
    help
      One binding that holds two behaviors at once (a keycode and a mouse
      button, for example) and releases both. Used for the trackpad's
      "held while a finger is on the pad" position.
```
