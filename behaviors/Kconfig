## dts/bindings/behavior/zmk,behavior-drag-click.yaml
```yaml
description: |
  Mouse button that stays pressed while a finger is on a trackpad.

  Pressing the key presses the mouse button and, when "layer" is set,
  activates that layer (like &mkp together with &mo). Releasing the key
  releases both immediately unless a finger is on one of the trackpads; then
  the release waits until every finger has left, so a drag started with the
  switch under the pad continues while the finger keeps moving.

  Needs CONFIG_INPUT_IQS9151_TOUCH_STATE_ENABLE=y on every half whose pad
  should count, and a zmk,input-listener whose "device" is this node so the
  button reaches the HID report:

      drag_lclk: drag_lclk {
          compatible = "zmk,behavior-drag-click";
          #binding-cells = <0>;
          display-name = "Left Click (Drag)";
          button = <0>;
          layer = <2>;
      };
      drag_lclk_listener {
          compatible = "zmk,input-listener";
          device = <&drag_lclk>;
      };

compatible: "zmk,behavior-drag-click"

properties:
  display-name:
    type: string

  "#binding-cells":
    type: int
    required: true
    const: 0

  button:
    type: int
    default: 0
    description: Mouse button, 0..4 = MB1..MB5. Default 0 (left).

  layer:
    type: int
    description: Layer index to hold together with the button. Omit for none.
```

## dts/bindings/behavior/zmk,behavior-press-both.yaml
```yaml
description: |
  One binding that holds two behaviors at once.

  `&tp_hold LSHIFT MB3` presses the first behavior in "bindings" with the
  first parameter and the second behavior with the second parameter, and
  releases both when the key is released. A parameter of 0 skips that
  behavior. Made for the trackpad's "held while a finger is on the pad"
  position, where a modifier and a mouse button are wanted together:

      tp_hold: tp_hold {
          compatible = "zmk,behavior-press-both";
          #binding-cells = <2>;
          display-name = "Key + Mouse Button";
          bindings = <&kp>, <&mkp>;
      };

  Parameter metadata comes from the two behaviors, so Keeb-On! Studio
  offers a keycode for the first parameter and a mouse button for the
  second.

compatible: "zmk,behavior-press-both"

properties:
  display-name:
    type: string

  "#binding-cells":
    type: int
    required: true
    const: 2

  bindings:
    type: phandles
    required: true
    description: Exactly two one-parameter behaviors, first then second.
```

## dts/bindings/input/azoteq,iqs9151.yaml
```yaml
description: |
  Azoteq IQS9151 driver placeholder.

compatible: "azoteq,iqs9151"

include: i2c-device.yaml

properties:
  irq-gpios:
    type: phandle-array
    required: true
    description: Interrupt GPIO for IQS9151 driver.
```

## dts/bindings/input_processors/zmk,input-processor-behaviors-consume.yaml
```yaml
# Copyright (c) 2026
# SPDX-License-Identifier: MIT

description: Input processor that invokes behaviors and neutralizes matched events

compatible: "zmk,input-processor-behaviors-consume"

include: ip_zero_param.yaml

properties:
  type:
    type: int
  codes:
    type: array
    required: true
  bindings:
    type: phandle-array
    required: true
  held-codes:
    type: array
    required: false
    description: |
      Codes from "codes" that are state events shared by every input device
      going through this processor, not gestures: the binding is pressed when
      the first device reports 1 and released when the last reports 0, and
      the event is passed on unchanged for processors further down the chain.
  held-skip-default-layer:
    type: boolean
    description: |
      A touch that begins with the default layer on top presses no held
      binding, whatever that layer has on the position. Held bindings also
      follow the top layer: leaving the layer releases them at once.
```

## dts/bindings/input_processors/zmk,input-processor-dual-pad.yaml
```yaml
# SPDX-License-Identifier: MIT

description: |
  Fuses one finger on each half of a split trackpad into a single gesture.
  Reference it from both listeners with param1 = 0 for the left pad and
  param1 = 1 for the right one; the two references share state. param2 carries
  flags for that reference (see dt-bindings/zmk/dual_pad.h): bit 0 inverts
  scroll, bit 1 inverts zoom, and bits 8..11 are the index into
  scroll-processors of the runtime scroll processor this chain uses, so the
  two-hand scroll follows the same runtime invert and speed as the one-pad
  scroll on that chain.

compatible: "zmk,input-processor-dual-pad"

include: ip_two_param.yaml

properties:
  touch-code:
    type: int
    default: 264
    description: Key code each half reports while its pad is being touched (264 = INPUT_BTN_8).

  scroll-start:
    type: int
    default: 30
    description: Shared movement, in device counts, before the gesture is treated as a scroll.

  zoom-start:
    type: int
    default: 60
    description: Separation between the two fingers, in device counts, before it is a zoom.

  scroll-divisor:
    type: int
    default: 16
    description: |
      Device counts per unit of scroll output. The pad's own counts: the
      pointer movement this processor receives has been through the cursor
      gain and the dynamic pointer scale, and both are divided out again (and
      the dynamic scroll scale applied) before this divisor, so that a finger
      on each pad scrolls at the same rate as two fingers on one pad going
      through the ordinary scroll chain with the same divisor.

  vertical-pad-axis:
    type: string
    default: "x"
    enum: ["x", "y"]
    description: |
      Which axis of the pad arrives here as vertical (INPUT_REL_Y) movement,
      so the right cursor gain is divided out: "x" when the listener swaps the
      axes before this processor (the pad's long axis is the screen's
      vertical), "y" when it does not.

  zoom-divisor:
    type: int
    default: 24
    description: Device counts of separation per unit of zoom output.

  invert-scroll:
    type: boolean
    description: Flip the scroll direction.

  invert-zoom:
    type: boolean
    description: Flip which way pinching in and out zooms.

  scroll-processors:
    type: phandles
    description: |
      The runtime scroll processors (zmk,input-processor-runtime) the
      listener chains put two-finger scroll through, one per chain that
      references this node with a different DUAL_PAD_SCROLL_PROC index. The
      processor named by the reference's index lends its axis invert and its
      scale to the two-hand scroll, which this processor emits after the
      chain's own scroll processing has already run. Without it the two-hand
      scroll ignores the app's scroll invert and speed.

  bindings:
    type: phandle-array
    description: |
      Behavior held down while zooming, so the host turns the wheel output
      into zoom - typically &kp LGUI on macOS or &kp LCTRL elsewhere.
```
