## drivers/input/Kconfig
```kconfig
menuconfig INPUT_IQS9151
    bool "Azoteq IQS9151 driver"
    default y
    depends on GPIO
    depends on I2C
    depends on INPUT
    depends on DT_HAS_AZOTEQ_IQS9151_ENABLED
    help
      Enable the AZOTEQ IQS9151 trackpad driver.

if INPUT_IQS9151

config INPUT_IQS9151_LOG_LEVEL
    int "IQS9151 log level"
    range 0 4
    default INPUT_LOG_LEVEL if LOG
    default 0
    help
      Log level for the IQS9151 driver module.
      0: none, 1: err, 2: wrn, 3: inf, 4: dbg.
      Defaults to INPUT_LOG_LEVEL to follow input subsystem policy.

config INPUT_IQS9151_INIT_PRIORITY
    int "IQS9151 init priority"
    default 80
    help
      Define the initialization priority for the IQS9151 driver.

choice INPUT_IQS9151_ROTATE
    prompt "IQS9151 rotate"
    default INPUT_IQS9151_ROTATE_0
    help
      Rotate the trackpad coordinate system (0/90/180/270).
      Currently not applied by the driver.

config INPUT_IQS9151_ROTATE_0
    bool "0"

config INPUT_IQS9151_ROTATE_90
    bool "90"

config INPUT_IQS9151_ROTATE_180
    bool "180"

config INPUT_IQS9151_ROTATE_270
    bool "270"
endchoice

config INPUT_IQS9151_RESOLUTION_X
    int "IQS9151 X resolution"
    range 0 4095
    default 2457
    help
      X Resolution (0x11E6), written to the IC at init.
      Limited to 0-4095 to match the practical 12-bit trackpad
      coordinate scale used by the device configuration.

      **This is not the cursor speed knob.** Measured on real hardware, across
      three flashes and both halves: moving X from 1300 to 1974 changed the
      pointer not at all. The Relative X/Y the cursor is built from does not
      come out of these registers. Use INPUT_IQS9151_CURSOR_GAIN_X_X10 for
      pointer speed.

      What it does set is the range of the *absolute* finger coordinates, and
      those are what every gesture decision in this driver compares -- which
      axis a scroll is on, whether a swipe beat the other direction, whether
      fingers spreading beat the pair travelling. So set the two in proportion
      to the pad's physical sides and those comparisons mean angles; leave them
      mismatched and all of them lean toward the denser axis, with no threshold
      adjustment able to straighten it out.

      Start from the sensor's own value for the shorter side and scale the
      other by the ratio of the sides.

config INPUT_IQS9151_RESOLUTION_Y
    int "IQS9151 Y resolution"
    range 0 4095
    default 3072
    help
      Y Resolution (0x11E8), written to the IC at init.
      Limited to 0-4095 to match the practical 12-bit trackpad
      coordinate scale used by the device configuration.

      See INPUT_IQS9151_RESOLUTION_X: the two only mean anything as a pair.
      With INPUT_IQS9151_RUNTIME_SETTINGS both become the *defaults* for a
      setting the owner can move from the app, which is the practical way to
      find the pair -- the board drawing gives the copper outline, not the
      electrode array, and a ratio derived from the wrong one is wrong by
      however much those two differ.

config INPUT_IQS9151_CURSOR_GAIN_X_X10
    int "IQS9151 cursor gain, sensor X axis (tenths)"
    range 1 200
    default 10
    help
      Multiplier applied to the relative movement the device reports on its X
      axis, in tenths: 10 is unchanged, 16 is 1.6x.

      This exists because the resolution registers do not do it. Those set the
      range of the *absolute* finger coordinates, which is what the gesture
      arbitration compares -- so they stay the right lever for which axis a
      scroll is on -- but the Relative X/Y the cursor is built from does not
      come out of them. Changing X resolution and measuring no change in cursor
      speed is the expected result, not a broken write.

      A pad longer one way than the other needs its long axis multiplied to
      move the pointer as far for the same finger travel. On a keyboard it
      usually wants a little more than the ratio of the sides, because the long
      side cannot be swept end to end in one stroke the way the short one can:
      matching millimetres still leaves that direction feeling reluctant.

      Fractional gains work because the tenths are carried between reports.
      Without that carry, a 1.6x gain on the one- and two-count reports a
      trackpad actually sends rounds back to 1x and does nothing.

config INPUT_IQS9151_CURSOR_GAIN_Y_X10
    int "IQS9151 cursor gain, sensor Y axis (tenths)"
    range 1 200
    default 10
    help
      The same for the sensor's Y axis. Note the listener's XY_SWAP: on a pad
      mounted like ErgoTrack's, the sensor's X is the screen's vertical and its
      Y is the screen's horizontal.

      Raising one axis and lowering the other keeps the overall pointer speed
      roughly where it was while changing the balance between them.

config INPUT_IQS9151_RECOVERY_STACK_SIZE
    int "IQS9151 reset-recovery thread stack size"
    default 1536
    help
      Stack for the thread that rewrites the device's configuration after the
      device reports it has reset itself (SHOW_RESET).

      It exists so that rebuild does not run on the system work queue. The
      rebuild is the same sequence init performs -- acknowledge the reset,
      write the settings blob in chunks, apply the overrides, re-tune ATI --
      which is seconds of I2C with sleeps in it. ZMK's watchdog watches the
      system work queue by feeding from a work item on it, so occupying that
      queue for seconds reboots the keyboard with nothing in the log to explain
      it. A trackpad having a bad moment should not be able to do that.

config INPUT_IQS9151_RECOVERY_THREAD_PRIORITY
    int "IQS9151 reset-recovery thread priority"
    default 10
    help
      Cooperative-range priorities are a bad idea here: the rebuild sleeps and
      waits on a busy device, and must never hold the CPU against the input or
      Bluetooth work that keeps the keyboard usable. A low preemptible priority
      is right -- the pad is already not working while this runs, so finishing
      quickly matters less than not getting in the way.

config INPUT_IQS9151_ATI_TARGETCOUNT
    int "IQS9151 ATI target count"
    range 0 1000
    default 250
    help
      Trackpad ATI Target (0x119A).
      Limited to 0-1000 to avoid unstable behavior.
      Currently not applied by the driver.

config INPUT_IQS9151_DYNAMIC_FILTER_BOTTOM_SPEED
    int "IQS9151 dynamic filter bottom speed"
    range 0 2047
    default 30
    help
      XY Dynamic Filter Bottom Speed (0x11EA).
      Limited to 0-2047 to stay within the documented trackpad count
      upper-limit scale.
      Currently not applied by the driver.

config INPUT_IQS9151_DYNAMIC_FILTER_TOP_SPEED
    int "IQS9151 dynamic filter top speed"
    range 0 2047
    default 511
    help
      XY Dynamic Filter Top Speed (0x11EC).
      Limited to 0-2047 to stay within the documented trackpad count
      upper-limit scale.
      Currently not applied by the driver.

config INPUT_IQS9151_DYNAMIC_FILTER_BOTTOM_BETA
    int "IQS9151 dynamic filter bottom beta"
    range 0 255
    default 20
    help
      XY Dynamic Filter Bottom Beta (0x11EE).
      Currently not applied by the driver.

config INPUT_IQS9151_TOUCH_STATE_ENABLE
    bool "IQS9151 raw touch state event"
    default n
    help
      Emit a key event whenever a finger touches or leaves the trackpad,
      independent of gesture detection. On a split keyboard only processed
      input events are relayed between halves, so enabling this on one half
      lets the other half react to "that pad is being touched" - for example
      to hold a layer while the other hand rests on its trackpad.

config INPUT_IQS9151_TOUCH_STATE_CODE
    int "IQS9151 touch state event code"
    depends on INPUT_IQS9151_TOUCH_STATE_ENABLE
    default 264
    help
      Input event code reported for the touch state. Defaults to 264
      (INPUT_BTN_8), which is not used by any of the gesture events
      (BTN_0..BTN_7).

config INPUT_IQS9151_TOUCH_STATE_2F_CODE
    int "IQS9151 two-finger touch state event code"
    depends on INPUT_IQS9151_TOUCH_STATE_ENABLE
    default 265
    help
      Input event code reported while two or more fingers are on the pad.
      Defaults to 265 (INPUT_BTN_9). Reported alongside the single-finger
      touch state, so two fingers raise both codes.

config INPUT_IQS9151_1F_TAP_ENABLE
    bool "IQS9151 single-finger tap enable"
    default y
    help
      Enable single-finger tap detection in the driver.

config INPUT_IQS9151_1F_TAP_MAX_MS
    int "IQS9151 single-finger tap max time (ms)"
    range 1 1000
    default 250
    help
      Maximum down duration for 1F tap detection (driver-side).

config INPUT_IQS9151_1F_TAP_MOVE
    int "IQS9151 single-finger tap move threshold"
    range 1 1000
    default 50
    help
      Maximum accumulated movement for 1F tap detection (driver-side).

config INPUT_IQS9151_1F_PRESSHOLD_ENABLE
    bool "IQS9151 single-finger press/hold enable"
    default y
    help
      Enable single-finger deferred-click/drag behavior in the driver.
      Behavior: first tap presses BTN0 immediately and keeps it pressed
      while waiting for a second touch.

config INPUT_IQS9151_1F_TAPDRAG_GAP_MAX_MS
    int "IQS9151 single-finger deferred-click second-touch max time (ms)"
    range 1 1000
    default 160
    help
      Maximum time to keep BTN0 pressed after a 1F tap while waiting
      for a second touch (driver-side).

config INPUT_IQS9151_CURSOR_INERTIA_ENABLE
    bool "IQS9151 cursor inertia enable"
    default y
    help
      Enable cursor inertia (driver-side).

config INPUT_IQS9151_CURSOR_INERTIA_DECAY
    int "IQS9151 cursor inertia decay"
    range 0 1000
    default 950
    help
      Cursor inertia decay (driver-side).

config INPUT_IQS9151_CURSOR_INERTIA_RECENT_WINDOW_MS
    int "IQS9151 cursor inertia recent window (ms)"
    range 1 500
    default 60
    help
      Time window used to evaluate recent single-finger motion before
      allowing cursor inertia to start.

config INPUT_IQS9151_CURSOR_INERTIA_STALE_GAP_MS
    int "IQS9151 cursor inertia stale gap (ms)"
    range 1 500
    default 35
    help
      Maximum allowed time from the last single-finger motion sample to
      finger release for cursor inertia to start.

config INPUT_IQS9151_CURSOR_INERTIA_MIN_SAMPLES
    int "IQS9151 cursor inertia minimum recent samples"
    range 1 12
    default 2
    help
      Minimum count of recent single-finger motion samples required to
      start cursor inertia.

config INPUT_IQS9151_CURSOR_INERTIA_MIN_AVG_SPEED
    int "IQS9151 cursor inertia minimum average speed"
    range 1 500
    default 10
    help
      Minimum average recent single-finger speed required to start
      cursor inertia.

config INPUT_IQS9151_2F_TAP_ENABLE
    bool "IQS9151 two-finger tap enable"
    default y
    help
      Enable two-finger tap detection in the driver.

config INPUT_IQS9151_2F_TAP_MAX_MS
    int "IQS9151 two-finger tap max time (ms)"
    range 1 1000
    default 250
    help
      Maximum down duration for 2F tap detection (driver-side).

config INPUT_IQS9151_2F_TAP_MOVE
    int "IQS9151 two-finger tap move threshold"
    range 1 1000
    default 50
    help
      Maximum centroid/distance movement for 2F tap detection (driver-side).

config INPUT_IQS9151_2F_PRESSHOLD_ENABLE
    bool "IQS9151 two-finger press/hold enable"
    default y
    help
      Enable two-finger deferred-click/drag behavior in the driver.
      Behavior: first 2F tap presses BTN1 immediately and keeps it pressed
      while waiting for a second 2F touch.

config INPUT_IQS9151_2F_TAPDRAG_GAP_MAX_MS
    int "IQS9151 two-finger deferred-click second-touch max time (ms)"
    range 1 1000
    default 200
    help
      Maximum time to keep BTN1 pressed after a 2F tap while waiting
      for a second 2F touch (driver-side).

config INPUT_IQS9151_SCROLL_Y_ENABLE
    bool "IQS9151 vertical scroll enable"
    default y
    help
      Enable driver-side vertical two-finger scroll.

config INPUT_IQS9151_SCROLL_X_ENABLE
    bool "IQS9151 horizontal scroll enable"
    default y
    help
      Enable driver-side horizontal two-finger scroll.

config INPUT_IQS9151_2F_SCROLL_START_MOVE
    int "IQS9151 two-finger scroll start threshold"
    range 1 2000
    default 50
    help
      Movement threshold to start 2F scroll mode (driver-side).

config INPUT_IQS9151_SCROLL_INERTIA_ENABLE
    bool "IQS9151 scroll inertia enable"
    default y
    help
      Enable scroll inertia (driver-side).

config INPUT_IQS9151_SCROLL_INERTIA_DECAY
    int "IQS9151 scroll inertia decay"
    range 0 1000
    default 980
    help
      Scroll inertia decay (driver-side).

config INPUT_IQS9151_SCROLL_INERTIA_RECENT_WINDOW_MS
    int "IQS9151 scroll inertia recent window (ms)"
    range 1 500
    default 60
    help
      Time window used to evaluate recent two-finger scroll motion
      before allowing scroll inertia to start.

config INPUT_IQS9151_SCROLL_INERTIA_STALE_GAP_MS
    int "IQS9151 scroll inertia stale gap (ms)"
    range 1 500
    default 35
    help
      Maximum allowed time from the last two-finger scroll sample to
      release for scroll inertia to start.

config INPUT_IQS9151_SCROLL_INERTIA_MIN_SAMPLES
    int "IQS9151 scroll inertia minimum recent samples"
    range 1 12
    default 1
    help
      Minimum count of recent two-finger scroll samples required to
      start scroll inertia.

config INPUT_IQS9151_SCROLL_INERTIA_MIN_AVG_SPEED
    int "IQS9151 scroll inertia minimum average speed"
    range 1 500
    default 4
    help
      Minimum average recent two-finger scroll speed required to start
      scroll inertia.

config INPUT_IQS9151_2F_PINCH_ENABLE
    bool "IQS9151 two-finger pinch enable"
    default y
    help
      Enable driver-side two-finger pinch detection.

config INPUT_IQS9151_2F_PINCH_START_DISTANCE
    int "IQS9151 two-finger pinch start threshold"
    range 1 2000
    default 100
    help
      Distance-delta threshold to start 2F pinch mode (driver-side).

config INPUT_IQS9151_2F_PINCH_DOMINANCE_X10
    int "IQS9151 how decisively a pinch must beat a scroll (tenths)"
    range 10 100
    default 10
    help
      How much larger the change in the distance between the two fingers must
      be than the distance their centroid travelled, before two fingers are
      read as a pinch rather than a scroll. In tenths: 10 is "merely larger",
      20 is "twice as large".

      Both numbers come from the same pair of fingers. A careful scroll moves
      the centroid and leaves the spacing alone, so 10 is enough. A hurried one
      is not so tidy -- fingers splay a little as they travel -- and on a small
      pad that is enough to land an intended scroll on pinch. Raising this asks
      that the spreading be the dominant thing happening, without making a
      deliberate pinch need a wider spread the way raising the start threshold
      would.

config INPUT_IQS9151_2F_PINCH_WHEEL_GAIN_X10
    int "IQS9151 two-finger pinch wheel gain (x10)"
    range 1 100
    default 40
    help
      Gain for 2F pinch REL_WHEEL output inside the driver.
      10 = 1.0x, 20 = 2.0x, 5 = 0.5x.

config INPUT_IQS9151_2F_PINCH_WHEEL_HORIZONTAL
    bool "IQS9151 report pinch on the horizontal wheel"
    default n
    help
      Report the 2F pinch wheel as REL_HWHEEL instead of REL_WHEEL. Enable
      this when the listener corrects a rotated pad with
      zip_scroll_transform INPUT_TRANSFORM_XY_SWAP: that swap applies to
      every wheel event, so pinch would otherwise arrive at the host as a
      horizontal scroll and never zoom.

config INPUT_IQS9151_2F_PINCH_INVERT
    bool "IQS9151 invert the two-finger pinch direction"
    default n
    help
      Turn the pinch wheel the other way, so spreading the fingers zooms out
      and closing them zooms in.

      Which direction is right is the host's convention rather than anything
      about the pad, so there is no value that is correct everywhere. With
      INPUT_IQS9151_RUNTIME_SETTINGS this is only the default and the owner
      can change it from the app; without it, it is the answer.

config INPUT_IQS9151_RUNTIME_SETTINGS
    bool "IQS9151 settings the owner can change from the app"
    default n
    depends on ZMK_CUSTOM_SETTINGS
    help
      Publish the trackpad decisions that are the user's rather than the
      board's -- whether one-pad pinch is offered, and which way it zooms --
      as custom settings, so they can be changed from a configurator instead
      of by rebuilding and reflashing.

      The Kconfig switches above become the defaults. A keyboard nobody has
      touched behaves exactly as its .conf says.

      On a split, enable this on BOTH halves: each half classifies gestures on
      its own sensor and reads its own copy of the setting. The write reaches
      both only if the client asks for every side
      (ZMK_CUSTOM_SETTING_SOURCE_ALL), which needs
      ZMK_CUSTOM_SETTINGS_SPLIT_RPC_RELAY on both halves too.

config INPUT_IQS9151_RUNTIME_SETTINGS_STUDIO_RPC
    bool "IQS9151 expose the runtime settings to Studio"
    default y
    depends on INPUT_IQS9151_RUNTIME_SETTINGS && ZMK_STUDIO
    select ZMK_CUSTOM_SETTINGS_STUDIO_RPC
    help
      Register the trackpad as a Studio custom subsystem. There is no RPC of
      its own, but a setting whose subsystem id matches no registered
      subsystem is dropped from ListSettings, so without this the settings
      exist on the keyboard and the app cannot see them.

      Only the central half needs this.

config INPUT_IQS9151_3F_TAP_ENABLE
    bool "IQS9151 three-finger tap enable"
    default y
    help
      Enable three-finger tap (driver-side).

config INPUT_IQS9151_3F_TAP_MAX_MS
    int "IQS9151 three-finger tap max time (ms)"
    range 1 1000
    default 200
    help
      Maximum down duration for 3F tap detection (driver-side).

config INPUT_IQS9151_3F_TAP_MOVE
    int "IQS9151 three-finger tap move threshold"
    range 1 1000
    default 35
    help
      Maximum finger1 tracked movement for 3F tap detection (driver-side).

config INPUT_IQS9151_3F_PRESSHOLD_ENABLE
    bool "IQS9151 three-finger press/hold enable"
    default y
    help
      Enable three-finger deferred-click/drag behavior in the driver.
      Behavior: first 3F tap presses BTN2 immediately and keeps it pressed
      while waiting for a second 3F touch.

config INPUT_IQS9151_3F_TAPDRAG_GAP_MAX_MS
    int "IQS9151 three-finger deferred-click second-touch max time (ms)"
    range 1 1000
    default 200
    help
      Maximum time to keep BTN2 pressed after a 3F tap while waiting
      for a second 3F touch (driver-side).

config INPUT_IQS9151_3F_SWIPE_THRESHOLD
    int "IQS9151 three-finger swipe threshold (sensor X axis)"
    range 0 1000
    default 200
    help
      How far three fingers must travel along the sensor's X axis before the
      movement counts as a swipe.

config INPUT_IQS9151_3F_SWIPE_THRESHOLD_Y
    int "IQS9151 three-finger swipe threshold (sensor Y axis)"
    range 0 1000
    default INPUT_IQS9151_3F_SWIPE_THRESHOLD
    help
      The same for the sensor's Y axis. Defaults to the X threshold, so a board
      with nothing to say about this keeps the single number it always had.

      Worth lowering on a pad that is much longer one way than the other. Three
      fingers lie across the short side and take up most of it, so there is very
      little room left to travel that way before one of them runs off the
      sensor -- while the long side has room to spare. One threshold for both
      makes the cramped direction the hard one no matter how comfortable the
      other feels.

config INPUT_IQS9151_SWIPE_INVERT_X
    bool "IQS9151 invert the swipe X axis"
    default n
    help
      Swap which way a swipe along the sensor's X axis counts, so a gesture
      that reported BTN_3 reports BTN_4 and the other way round.

      A swipe is classified in the driver, on the sensor's own coordinates,
      because it is one decision about a whole gesture rather than a stream of
      deltas. The listener's XY_SWAP / X_INVERT / Y_INVERT chain -- which is
      what normally squares a rotated pad with the screen -- therefore never
      sees it, and a pad mounted the other way round moves the cursor
      correctly while swiping backwards. This is that correction.

config INPUT_IQS9151_SWIPE_INVERT_Y
    bool "IQS9151 invert the swipe Y axis"
    default n
    help
      The same for the sensor's Y axis: the three-finger pair BTN_5/BTN_6, and
      the two-finger horizontal swipe below.

      Setting both is the 180-degree case: the mirror-image half of a split,
      where the same sensor part is fitted upside down and every swipe comes
      out backwards on both axes.

config INPUT_IQS9151_2F_SWIPE_ENABLE
    bool "IQS9151 two-finger horizontal swipe"
    default n
    help
      Report a decisive sideways movement of two fingers as a single key tap,
      so the keymap can put browser back/forward -- or anything else -- on it.
      The two directions report BTN_SIDE and BTN_EXTRA; which is which depends
      on how the pad is mounted, so try it rather than assuming.

      This costs two-finger horizontal *scroll*, and the trade is not
      avoidable: a sideways movement cannot both start a scroll immediately and
      be held back long enough to be recognised as a gesture. While a movement
      is decisively sideways, scroll is not allowed to start; one that turns
      out to be vertical after all scrolls as usual. Vertical scroll is
      untouched.

config INPUT_IQS9151_2F_SCROLL_AXIS_LOCK_X10
    int "IQS9151 keep a two-finger scroll on the axis it started on (tenths)"
    range 0 100
    default 0
    help
      How much one axis must lead the other, when a scroll starts, for the
      scroll to be held to that axis for the rest of the gesture. In tenths:
      12 means "1.2x the other", which is everything within roughly 40 degrees
      of straight. 0 disables it and both axes pass through as they always did.

      A trackpad in a keyboard is not always approached square-on. Reaching for
      it from the home row puts the hand at an angle, and then "straight up" is
      a diagonal as far as the pad is concerned -- so a scroll meant as vertical
      arrives as vertical-plus-a-bit-sideways and the page drifts while it
      scrolls. Picking the axis once, at the start, is what stops that.

      This compares the two axes' counts, which is only an angle if both axes
      report the same counts per millimetre. On a pad whose sides differ that is
      a resolution question -- see INPUT_IQS9151_RESOLUTION_X.

config INPUT_IQS9151_2F_SWIPE_THRESHOLD
    int "IQS9151 two-finger horizontal swipe threshold"
    range 1 1000
    default 200
    help
      How far sideways the two fingers must travel before the swipe is
      reported.

config INPUT_IQS9151_2F_SWIPE_DOMINANCE_X10
    int "IQS9151 how sideways a two-finger swipe must be (tenths)"
    range 10 100
    default 20
    help
      How much larger the sideways travel must be than the vertical travel for
      a two-finger movement to count as a horizontal swipe. In tenths: 20 means
      twice as far sideways as up or down.

      This is also what keeps a slightly crooked vertical scroll out of the
      swipe: below this ratio the movement is a scroll, whatever its length.

config INPUT_IQS9151_TEST
    bool "IQS9151 test hooks"
    depends on ZTEST
    default n
    help
      Expose IQS9151 internal test APIs and event hooks for ZTEST.

endif
```
